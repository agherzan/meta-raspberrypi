## conf/bblayers.conf.sample
```bitbake
# POKY_BBLAYERS_CONF_VERSION is increased each time build/conf/bblayers.conf
# changes incompatibly
POKY_BBLAYERS_CONF_VERSION = "2"

BBPATH = "${TOPDIR}"
BBFILES ?= ""

BBLAYERS ?= " \
    ##COREBASE##/meta \
    ##COREBASE##/meta-poky \
    ##COREBASE##/../meta-openembedded/meta-oe \
    ##COREBASE##/../meta-openembedded/meta-multimedia \
    ##COREBASE##/../meta-openembedded/meta-networking \
    ##COREBASE##/../meta-openembedded/meta-webserver \
    ##COREBASE##/../meta-openembedded/meta-python \
    ##COREBASE##/../meta-qt5 \
    ##COREBASE##/../meta-raspberrypi \
  "
```

## conf/distro/poky-raspberrypi.conf
```bitbake
require conf/distro/poky.conf

# Systemd is not yet in poky
# rpi-zram-service is a systemd service
# and it needs systemd
BBMASK ?= "rpi-zram-service"
```

## conf/layer.conf
```bitbake
# We have a conf and classes directory, append to BBPATH
BBPATH .= ":${LAYERDIR}"

# We have a recipes directory containing .bb and .bbappend files, add to BBFILES
BBFILES += "${LAYERDIR}/recipes*/*/*.bb \
            ${LAYERDIR}/recipes*/*/*.bbappend"

BBFILE_COLLECTIONS += "raspberrypi"
BBFILE_PATTERN_raspberrypi := "^${LAYERDIR}/"
BBFILE_PRIORITY_raspberrypi = "9"

# Additional license directories.
LICENSE_PATH += "${LAYERDIR}/files/custom-licenses"

# Let us add layer-specific bbappends which are only applied when that
# layer is included in our configuration
BBFILES += "${@' '.join('${LAYERDIR}/%s/recipes*/*/*.bbappend' % layer \
               for layer in BBFILE_COLLECTIONS.split())}"
# Add layer-specific bb files too
BBFILES += "${@' '.join('${LAYERDIR}/%s/recipes*/*/*.bb' % layer \
               for layer in BBFILE_COLLECTIONS.split())}"
```

## conf/local.conf.sample
```bitbake
MACHINE ??= "raspberrypi3"

DL_DIR ?= "${TOPDIR}/downloads"
SSTATE_DIR ?= "${TOPDIR}/sstate-cache"
TMPDIR = "${TOPDIR}/tmp"

DISTRO ?= "poky"
DISTRO_FEATURES_append = " pam egl gles"
DISTRO_FEATURES_remove = " x11 wayland vulkan"

PACKAGE_CLASSES ?= "package_ipk"

# SDK target architecture
#SDKMACHINE ?= "x86_64"

EXTRA_IMAGE_FEATURES ?= "debug-tweaks dev-pkgs tools-sdk tools-profile tools-testapps"

USER_CLASSES ?= "buildstats image-mklibs image-prelink"

OE_TERMINAL = "auto"

PATCHRESOLVE = "noop"

BB_DISKMON_DIRS = "\
    STOPTASKS,${TMPDIR},1G,100K \
    STOPTASKS,${DL_DIR},1G,100K \
    STOPTASKS,${SSTATE_DIR},1G,100K \
    STOPTASKS,/tmp,100M,100K \
    ABORT,${TMPDIR},100M,1K \
    ABORT,${DL_DIR},100M,1K \
    ABORT,${SSTATE_DIR},100M,1K \
    ABORT,/tmp,10M,1K"

CONF_VERSION = "1"

BB_NUMBER_THREADS ?= "${@oe.utils.cpu_count()}"
PARALLEL_MAKE ?= "-j ${@oe.utils.cpu_count()}"

RM_OLD_IMAGE = "1"
# INHERIT += "rm_work"

LICENSE_FLAGS_WHITELIST = "commercial"

ENABLE_UART = "1"
ENABLE_RPI3_SERIAL_CONSOLE = "1"
ENABLE_SPI_BUS = "1"
ENABLE_I2C = "1"

GPU_MEM = "128"
VIDEO_CAMERA = "1"
```

## conf/machine/include/rpi-base.inc
```bitbake
include conf/machine/include/rpi-default-settings.inc
include conf/machine/include/rpi-default-versions.inc
include conf/machine/include/rpi-default-providers.inc

SOC_FAMILY = "rpi"
include conf/machine/include/soc-family.inc

IMAGE_FSTYPES ?= "tar.bz2 ext3 rpi-sdimg"

SERIAL_CONSOLE = "115200 ttyAMA0"

XSERVER = " \
    xserver-xorg \
    xf86-input-evdev \
    xf86-input-mouse \
    xf86-input-keyboard \
    xf86-video-fbdev \
    "

# Really supported starting from linux-raspberrypi 3.18.y only
KERNEL_DEVICETREE ?= " \
    bcm2708-rpi-b.dtb \
    bcm2708-rpi-b-plus.dtb \
    bcm2709-rpi-2-b.dtb \
    \
    overlays/ads7846-overlay.dtb \
    overlays/bmp085_i2c-sensor-overlay.dtb \
    overlays/dht11-overlay.dtb \
    overlays/enc28j60-overlay.dtb \
    overlays/gpio-poweroff-overlay.dtb \
    overlays/hifiberry-amp-overlay.dtb \
    overlays/hifiberry-dac-overlay.dtb \
    overlays/hifiberry-dacplus-overlay.dtb \
    overlays/hifiberry-digi-overlay.dtb \
    overlays/hy28a-overlay.dtb \
    overlays/hy28b-overlay.dtb \
    overlays/i2c-rtc-overlay.dtb \
    overlays/i2s-mmap-overlay.dtb \
    overlays/iqaudio-dac-overlay.dtb \
    overlays/iqaudio-dacplus-overlay.dtb \
    overlays/lirc-rpi-overlay.dtb \
    overlays/mcp2515-can0-overlay.dtb \
    overlays/mcp2515-can1-overlay.dtb \
    overlays/mmc-overlay.dtb \
    overlays/mz61581-overlay.dtb \
    overlays/piscreen-overlay.dtb \
    overlays/pitft28-resistive-overlay.dtb \
    overlays/pps-gpio-overlay.dtb \
    overlays/pwm-2chan-overlay.dtb \
    overlays/pwm-overlay.dtb \
    overlays/raspidac3-overlay.dtb \
    overlays/rpi-dac-overlay.dtb \
    overlays/rpi-display-overlay.dtb \
    overlays/rpi-ft5406-overlay.dtb \
    overlays/rpi-proto-overlay.dtb \
    overlays/rpi-sense-overlay.dtb \
    overlays/sdhost-overlay.dtb \
    overlays/sdio-overlay.dtb \
    overlays/smi-dev-overlay.dtb \
    overlays/smi-nand-overlay.dtb \
    overlays/smi-overlay.dtb \
    overlays/spi-bcm2708-overlay.dtb \
    overlays/spi-bcm2835-overlay.dtb \
    overlays/spi-dma-overlay.dtb \
    overlays/tinylcd35-overlay.dtb \
    overlays/uart1-overlay.dtb \
    overlays/vga666-overlay.dtb \
    overlays/w1-gpio-overlay.dtb \
    overlays/w1-gpio-pullup-overlay.dtb \
"

KERNEL_IMAGETYPE ?= "Image"

MACHINE_FEATURES = "kernel26 apm usbhost keyboard vfat ext2 screen touchscreen alsa bluetooth wifi sdio"

# Raspberry Pi has no hardware clock
MACHINE_FEATURES_BACKFILL_CONSIDERED = "rtc"

MACHINE_EXTRA_RRECOMMENDS += " kernel-modules"

# Set Raspberrypi splash image
SPLASH = "psplash-raspberrypi"

IMAGE_BOOT_FILES ?= "bcm2835-bootfiles/* ${KERNEL_IMAGETYPE};${SDIMG_KERNELIMAGE}"
```

## conf/machine/include/rpi-default-providers.inc
```bitbake
# RaspberryPi BSP default providers

PREFERRED_PROVIDER_virtual/kernel = "linux-raspberrypi"
PREFERRED_VERSION_linux-raspberrypi ?= "3.10.%"

PREFERRED_PROVIDER_u-boot = "u-boot-rpi"

PREFERRED_PROVIDER_virtual/xserver = "xserver-xorg"
PREFERRED_PROVIDER_virtual/egl ?= "userland"
PREFERRED_PROVIDER_virtual/libgles2 ?= "userland"
PREFERRED_PROVIDER_jpeg = "jpeg"
```

## conf/machine/include/rpi-default-settings.inc
```bitbake
# RaspberryPi BSP default settings

IMAGE_CLASSES += "sdcard_image-rpi"

# RPI kernel has errors of its own which should be filtered
# therefore use parselogs:rpi test instead of parselogs from oe-core
#
DEFAULT_TEST_SUITES:append:rpi = " parselogs:rpi"
DEFAULT_TEST_SUITES:remove:rpi = " parselogs"
```

## conf/machine/include/rpi-default-versions.inc
```bitbake
# RaspberryPi BSP default versions

PREFERRED_VERSION_linux-raspberrypi ??= "6.1.%"
```

## conf/machine/include/tune-arm1176jzf-s.inc
```bitbake
DEFAULTTUNE ?= "armv6"

require conf/machine/include/arm/arch-armv6.inc

TUNEVALID[arm1176jzfs] = "Enable arm1176jzfs specific processor optimizations"
TUNE_CCARGS += "${@bb.utils.contains("TUNE_FEATURES", "arm1176jzfs", "-mtune=arm1176jzf-s", "", d)}"

AVAILTUNES += "arm1176jzfs"
TUNE_FEATURES_tune-arm1176jzfs = "${TUNE_FEATURES_tune-armv6} arm1176jzfs"
ARMPKGARCH_tune-arm1176jzfs = "arm1176jzfs"
PACKAGE_EXTRA_ARCHS_tune-arm1176jzfs = "${PACKAGE_EXTRA_ARCHS_tune-armv6}"
```

## conf/machine/raspberrypi.conf
```bitbake
#@TYPE: Machine
#@NAME: RaspberryPi Development Board
#@DESCRIPTION: Machine configuration for the RaspberryPi http://www.raspberrypi.org/ Board
#@MAINTAINER: John Willis

include conf/machine/include/rpi-default-settings.inc
include conf/machine/include/rpi-default-versions.inc
include conf/machine/include/rpi-default-providers.inc
require conf/machine/include/tune-arm1176jzf-s.inc

IMAGE_FSTYPES ?= "tar.bz2 ext3 rpi-sdimg"

SERIAL_CONSOLE = "115200 ttyAMA0"

MACHINE_KERNEL_PR = "r5"

XSERVER = " \
	xserver-xorg \
	xf86-input-evdev \
	xf86-input-mouse \
	xf86-input-keyboard \
	xf86-video-fbdev \
"

KERNEL_IMAGETYPE ?= "Image"

# Really supported starting from linux-rapsberry 3.18.y only !
#KERNEL_DEVICETREE ?= " \
#	bcm2708-rpi-b.dtb \
#	bcm2708-rpi-b-plus.dtb \
#	ds1307-rtc-overlay.dtb \
#	hifiberry-amp-overlay.dtb \
#	hifiberry-dac-overlay.dtb \
#	hifiberry-dacplus-overlay.dtb \
#	hifiberry-digi-overlay.dtb \
#	iqaudio-dac-overlay.dtb \
#	iqaudio-dacplus-overlay.dtb \
#	lirc-rpi-overlay.dtb \
#	pcf8523-rtc-overlay.dtb \
#	pps-gpio-overlay.dtb \
#	w1-gpio-overlay.dtb \
#	w1-gpio-pullup-overlay.dtb \
#	"

MACHINE_FEATURES = "kernel26 apm usbhost keyboard vfat ext2 screen touchscreen alsa bluetooth wifi sdio"

#RaspberryPi has no hardware clock
MACHINE_FEATURES_BACKFILL_CONSIDERED = "rtc"

MACHINE_EXTRA_RRECOMMENDS += " \
	kernel-modules \
"

# Set raspberrypi splash image
SPLASH = "psplash-raspberrypi"

IMAGE_BOOT_FILES ?= "bcm2835-bootfiles/* ${KERNEL_IMAGETYPE};kernel.img"
```

## conf/machine/raspberrypi0-wifi.conf
```bitbake
#@TYPE: Machine
#@NAME: RaspberryPi Zero WiFi Development Board
#@DESCRIPTION: Machine configuration for the RaspberryPi Zero  WiFi board (https://www.raspberrypi.org/blog/raspberry-pi-zero-w-joins-family/)

SERIAL_CONSOLE ?= "115200 ttyS0"

MACHINE_EXTRA_RRECOMMENDS += "linux-firmware-bcm43430"

include conf/machine/raspberrypi0.conf
```

## conf/machine/raspberrypi2.conf
```bitbake
#@TYPE: Machine
#@NAME: RaspberryPi 2 Development Board
#@DESCRIPTION: Machine configuration for the RaspberryPi 2

# userland is not compiling on RPI 2
# https://github.com/raspberrypi/userland/issues/214
PREFERRED_PROVIDER_virtual/egl ?= "vc-graphics-hardfp"
PREFERRED_PROVIDER_virtual/libgles2 ?= "vc-graphics-hardfp"

DEFAULTTUNE ?= "cortexa7thf-neon-vfpv4"

require conf/machine/include/tune-cortexa7.inc
include conf/machine/include/rpi-base.inc
```

## conf/machine/raspberrypi3-64.conf
```bitbake
#@TYPE: Machine
#@NAME: RaspberryPi 3 Development Board
#@DESCRIPTION: Machine configuration for the RaspberryPi 3 in 64 bits mode

MACHINEOVERRIDES = "raspberrypi3:${MACHINE}"

# Set this early so it overrides rpi-default-versions.inc
PREFERRED_VERSION_linux-raspberrypi ?= "4.9.%"

require conf/machine/include/arm/arch-armv8.inc
include conf/machine/include/rpi-base.inc

KERNEL_DEVICETREE = " \
    broadcom/bcm2710-rpi-3-b.dtb \
    broadcom/bcm2837-rpi-3-b.dtb \
    \
    overlays/hifiberry-amp-overlay.dtb \
    overlays/hifiberry-dac-overlay.dtb \
    overlays/hifiberry-dacplus-overlay.dtb \
    overlays/hifiberry-digi-overlay.dtb \
    overlays/i2c-rtc-overlay.dtb \
    overlays/iqaudio-dac-overlay.dtb \
    overlays/iqaudio-dacplus-overlay.dtb \
    overlays/lirc-rpi-overlay.dtb \
    overlays/pitft22-overlay.dtb \
    overlays/pitft28-resistive-overlay.dtb \
    overlays/pps-gpio-overlay.dtb \
    overlays/rpi-ft5406-overlay.dtb \
    overlays/w1-gpio-overlay.dtb \
    overlays/w1-gpio-pullup-overlay.dtb \
    overlays/pi3-miniuart-bt-overlay.dtb \
    "

SERIAL_CONSOLE ?= "115200 ttyS0"

VC4_CMA_SIZE ?= "cma-256"

UBOOT_MACHINE = "rpi_3_config"
```

## conf/machine/raspberrypi3.conf
```bitbake
#@TYPE: Machine
#@NAME: RaspberryPi 3 Development Board (32bit)
#@DESCRIPTION: Machine configuration for the RaspberryPi 3 in 32 bits mode

DEFAULTTUNE ?= "cortexa7thf-neon-vfpv4"
require conf/machine/include/arm/armv7a/tune-cortexa7.inc
include conf/machine/include/rpi-base.inc

MACHINE_EXTRA_RRECOMMENDS += "${RASPBERRYPI_3_FIRMWARE_PACKAGES}"

SDIMG_KERNELIMAGE ?= "${RASPBERRYPI_3_KERNEL}"
UBOOT_MACHINE = "rpi_3_32b_config"
SERIAL_CONSOLES ?= "115200;ttyS0"

VC4DTBO ?= "vc4-fkms-v3d"
ARMSTUB ?= "armstub7.bin"
```

## conf/machine/raspberrypi4-64.conf
```bitbake
#@TYPE: Machine
#@NAME: RaspberryPi 4 Development Board (64bit)
#@DESCRIPTION: Machine configuration for the RaspberryPi 4 in 64 bits mode

MACHINEOVERRIDES = "raspberrypi4:${MACHINE}"

MACHINE_EXTRA_RRECOMMENDS += "\
    linux-firmware-rpidistro-bcm43455 \
    bluez-firmware-rpidistro-bcm4345c0-hcd \
"

require conf/machine/include/tune-cortexa72.inc
include conf/machine/include/rpi-base.inc

RPI_KERNEL_DEVICETREE = " \
    broadcom/bcm2711-rpi-4-b.dtb \
"

SDIMG_KERNELIMAGE ?= "kernel8.img"
SERIAL_CONSOLES ?= "115200;ttyS0"

MACHINE_FEATURES_append = " vc4graphics"
VC4DTBO ?= "vc4-fkms-v3d"
ARMSTUB ?= "armstub8-gic.bin"

KERNEL_IMAGETYPE_DIRECT ?= "Image"

RPI_EXTRA_CONFIG ?= "\n# RPi4 64bit has some limitation - see https://github.com/raspberrypi/linux/commit/cdb78ce891f6c6367a69c0a46b5779a58164bd4b\ntotal_mem=1024\narm_64bit=1"
```

## conf/machine/raspberrypi4.conf
```bitbake
#@TYPE: Machine
#@NAME: RaspberryPi 4 Development Board (32bit)
#@DESCRIPTION: Machine configuration for the RaspberryPi 4 in 32 bit mode

DEFAULTTUNE ?= "cortexa7thf-neon-vfpv4"
require conf/machine/include/arm/armv7a/tune-cortexa7.inc
include conf/machine/include/rpi-base.inc

MACHINE_FEATURES += "pci"

MACHINE_EXTRA_RRECOMMENDS += "${RASPBERRYPI_4_FIRMWARE_PACKAGES}"

SDIMG_KERNELIMAGE ?= "${RASPBERRYPI_4_KERNEL}"
UBOOT_MACHINE = "rpi_4_32b_config"
SERIAL_CONSOLES ?= "115200;ttyS0"

VC4DTBO ?= "vc4-kms-v3d"
ARMSTUB ?= "armstub7.bin"
```
